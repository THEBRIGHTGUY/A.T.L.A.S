// Minimal driver for the Heltec V4's built-in 0.96" OLED (SSD1306, 128 x 64, I2C). No library needed.
// The screen sits on its own I2C pins (Wire1), so it never disturbs the sensors on Wire.
#pragma once
#include <Wire.h>
#include "qr_v2.h"

#define OLED_SDA  17
#define OLED_SCL  18
#define OLED_RST  21
#define OLED_VEXT 36     // powers the screen; the code tries LOW then HIGH, so either board revision works
#define OLED_ADDR 0x3C
#define OLED_FLIP 1      // if the picture is upside down, change 1 to 0

static uint8_t oledBuf[128 * 8];   // one bit per pixel

// 5 x 7 font: capital letters, digits and a few symbols (lower case is shown as capitals)
static const char FONT_CHARS[] = " !%()*+,-./0123456789:<=>?ABCDEFGHIJKLMNOPQRSTUVWXYZ_";
static const uint8_t FONT[][5] = {
  {0x00,0x00,0x00,0x00,0x00}, {0x00,0x00,0x5F,0x00,0x00}, {0x23,0x13,0x08,0x64,0x62}, {0x00,0x1C,0x22,0x41,0x00},
  {0x00,0x41,0x22,0x1C,0x00}, {0x14,0x08,0x3E,0x08,0x14}, {0x08,0x08,0x3E,0x08,0x08}, {0x00,0x50,0x30,0x00,0x00},
  {0x08,0x08,0x08,0x08,0x08}, {0x00,0x60,0x60,0x00,0x00}, {0x20,0x10,0x08,0x04,0x02},
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  {0x40,0x40,0x40,0x40,0x40}
};

static void oledCmd(uint8_t c) {
  Wire1.beginTransmission(OLED_ADDR);
  Wire1.write((uint8_t)0x00);
  Wire1.write(c);
  Wire1.endTransmission();
}

static bool oledProbe() {
  Wire1.beginTransmission(OLED_ADDR);
  return Wire1.endTransmission() == 0;
}

static void oledPower(int level) {
  pinMode(OLED_VEXT, OUTPUT); digitalWrite(OLED_VEXT, level); delay(60);
  pinMode(OLED_RST, OUTPUT); digitalWrite(OLED_RST, LOW); delay(20); digitalWrite(OLED_RST, HIGH); delay(20);
}

static void oledShow() {
  oledCmd(0x21); oledCmd(0); oledCmd(127);   // columns 0..127
  oledCmd(0x22); oledCmd(0); oledCmd(7);     // pages 0..7
  for (int i = 0; i < 128 * 8; i += 16) {
    Wire1.beginTransmission(OLED_ADDR);
    Wire1.write((uint8_t)0x40);
    Wire1.write(oledBuf + i, 16);
    Wire1.endTransmission();
  }
}

static void oledClear() { memset(oledBuf, 0, sizeof oledBuf); }
static void oledOff()  { oledCmd(0xAE); }
static void oledWake() { oledCmd(0xAF); }

static bool oledBegin() {
  Wire1.begin(OLED_SDA, OLED_SCL);
  Wire1.setClock(400000);
  oledPower(LOW);                                       // Vext is active LOW on the V3 ...
  if (!oledProbe()) { oledPower(HIGH); if (!oledProbe()) return false; }   // ... and tried the other way round if needed
  const uint8_t init[] = {0xAE, 0xD5, 0x80, 0xA8, 0x3F, 0xD3, 0x00, 0x40, 0x8D, 0x14, 0x20, 0x00,
                          (uint8_t)(OLED_FLIP ? 0xA1 : 0xA0), (uint8_t)(OLED_FLIP ? 0xC8 : 0xC0),
                          0xDA, 0x12, 0x81, 0xCF, 0xD9, 0xF1, 0xDB, 0x40, 0xA4, 0xA6, 0xAF};
  for (uint8_t c : init) oledCmd(c);
  oledClear();
  oledShow();
  return true;
}

// ---------------------------------------------------------------- drawing
static void oledPixel(int x, int y, bool on) {
  if ((unsigned)x >= 128 || (unsigned)y >= 64) return;
  uint8_t m = 1 << (y & 7);
  uint8_t &b = oledBuf[x + (y >> 3) * 128];
  if (on) b |= m; else b &= ~m;
}

static void oledFill(int x, int y, int w, int h, bool on = true) {
  for (int j = 0; j < h; j++) for (int i = 0; i < w; i++) oledPixel(x + i, y + j, on);
}

static void oledFrame(int x, int y, int w, int h) {
  oledFill(x, y, w, 1); oledFill(x, y + h - 1, w, 1); oledFill(x, y, 1, h); oledFill(x + w - 1, y, 1, h);
}

static int oledTextWidth(const char *s, int size = 1) { int n = (int)strlen(s); return n ? n * 6 * size - size : 0; }

static void oledText(int x, int y, const char *s, int size = 1, bool on = true) {
  for (; *s; s++, x += 6 * size) {
    char c = *s; if (c >= 'a' && c <= 'z') c -= 32;
    const char *p = strchr(FONT_CHARS, c);
    const uint8_t *g = FONT[p ? p - FONT_CHARS : strchr(FONT_CHARS, '?') - FONT_CHARS];
    for (int col = 0; col < 5; col++) for (int row = 0; row < 7; row++)
      if ((g[col] >> row) & 1) oledFill(x + col * size, y + row * size, size, size, on);
  }
}

static void oledCenter(int y, const char *s, int size = 1) { oledText((128 - oledTextWidth(s, size)) / 2, y, s, size); }
static void oledRight(int y, const char *s, int size = 1)  { oledText(128 - oledTextWidth(s, size), y, s, size); }

// QR code drawn the way phones expect it: dark modules on a lit (white) square with a quiet border.
static void oledQR(const QrCode &q, int x0, int y0, int scale, int quiet) {
  int side = QR_SIZE * scale + 2 * quiet;
  oledFill(x0, y0, side, side, true);
  for (int y = 0; y < QR_SIZE; y++) for (int x = 0; x < QR_SIZE; x++)
    if (q.m[y][x]) oledFill(x0 + quiet + x * scale, y0 + quiet + y * scale, scale, scale, false);
}
